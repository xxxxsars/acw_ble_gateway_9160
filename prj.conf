## CMakeLists.txt
```
#
# Copyright (c) 2018 Nordic Semiconductor
#
# SPDX-License-Identifier: LicenseRef-Nordic-5-Clause
#

cmake_minimum_required(VERSION 3.20.0)

find_package(Zephyr REQUIRED HINTS $ENV{ZEPHYR_BASE})
project(lte-ble-gateway)


zephyr_include_directories(src)
include_directories(src/orientation_detector)


# NORDIC SDK APP 
FILE(GLOB app_sources src/*.c)
target_sources(app PRIVATE
	${app_sources}
)


# CUSTOM LIB
FILE(GLOB app_libary src/lib/*.c)
target_sources(app PRIVATE
	${app_libary}
)
```

## prj.conf
```kconfig
#
# Copyright (c) 2019 Nordic Semiconductor ASA
#
# SPDX-License-Identifier: LicenseRef-Nordic-5-Clause
#





# Socket API
CONFIG_NET_SOCKETS_POSIX_NAMES=y

# Cert API
CONFIG_MODEM_KEY_MGMT=y


# General config
CONFIG_NEWLIB_LIBC=y
CONFIG_ASSERT=y
CONFIG_REBOOT=y

# Network
CONFIG_NETWORKING=y
CONFIG_NET_NATIVE=n
CONFIG_NET_SOCKETS=y
CONFIG_NET_SOCKETS_OFFLOAD=y

# LTE link control
CONFIG_LTE_LINK_CONTROL=y
CONFIG_LTE_AUTO_INIT_AND_CONNECT=n

# # AT host
# CONFIG_AT_HOST_LIBRARY=y

# Modem library
CONFIG_NRF_MODEM_LIB=y

# Disable Modem traces, since we need UART1 for HCI
CONFIG_NRF_MODEM_LIB_TRACE_ENABLED=n

# # nRF Cloud
# CONFIG_NRF_CLOUD_MQTT=y

# # GPS
# CONFIG_GPS_USE_SIM=y

# For demo purposes, we acquire fix often
CONFIG_GPS_SEARCH_INTERVAL=30
CONFIG_GPS_SEARCH_TIMEOUT=15

# The two configurations below are required if using the nRF9160's built-in GPS
# CONFIG_NRF9160_GPS=y
# CONFIG_GPS_USE_NRF9160=y

# Library for buttons and LEDs
CONFIG_DK_LIBRARY=y
CONFIG_DK_LIBRARY_INVERT_LEDS=n

# Console for user association
CONFIG_CONSOLE_SUBSYS=y
CONFIG_CONSOLE_GETCHAR=y

# Enable Bluetooth stack and libraries
# CONFIG_BT=y
# CONFIG_BT_H4=y
# CONFIG_BT_WAIT_NOP=y
# CONFIG_BT_CENTRAL=y
# CONFIG_BT_GATT_CLIENT=y
# CONFIG_BT_GATT_DM=y
# CONFIG_BT_SCAN=y
# CONFIG_BT_SCAN_FILTER_ENABLE=y
# CONFIG_BT_SCAN_UUID_CNT=1


CONFIG_BT=y
# CONFIG_BT_DEBUG_LOG=y
CONFIG_BT_CENTRAL=y
CONFIG_BT_SMP=y
CONFIG_BT_GATT_CLIENT=y

# Enable bonding
CONFIG_BT_SETTINGS=y
CONFIG_SETTINGS=y

# Save paired device
CONFIG_FLASH=y
CONFIG_FLASH_PAGE_LAYOUT=y
CONFIG_FLASH_MAP=y
CONFIG_NVS=y
CONFIG_ASSERT=y

CONFIG_BT_AUTO_PHY_UPDATE=n
CONFIG_BT_PRIVACY=y
CONFIG_BT_MAX_CONN=3
CONFIG_BT_MAX_PAIRED=3


CONFIG_UART_INTERRUPT_DRIVEN=y

# Heap and stacks
CONFIG_HEAP_MEM_POOL_SIZE=16384
CONFIG_MAIN_STACK_SIZE=8192

# Mitigation for NCSIDB-356
CONFIG_ZERO_LATENCY_IRQS=n




# LOG
CONFIG_LOG=y
CONFIG_SERIAL=y
CONFIG_STDOUT_CONSOLE=y
# CONFIG_LTE_LINK_CONTROL_LOG_LEVEL=4
```

## src/main.c
```c
/*
 * Copyright (c) 2018 Nordic Semiconductor ASA
 *
 * SPDX-License-Identifier: LicenseRef-Nordic-5-Clause
 */

#include <zephyr.h>
#include <stdio.h>
#include <string.h>
#include <regex.h>


// #include <drivers/gps.h>
// #include <drivers/sensor.h>
#include <console/console.h>
// #include <net/nrf_cloud.h>
#include <dk_buttons_and_leds.h>
#include <modem/lte_lc.h>
#include <sys/reboot.h>
#include <modem/nrf_modem_lib.h>


// #include "lte.h"
#include "ble.h"
#include "lib/common.h"



#define BUTTON_1 BIT(0)
#define BUTTON_2 BIT(1)
#define SWITCH_1 BIT(2)
#define SWITCH_2 BIT(3)



/**@brief Callback for button events from the DK buttons and LEDs library. */
static void button_handler(uint32_t buttons, uint32_t has_changed)
{
	printk("button_handler: button 1: %u, button 2: %u "
	       "switch 1: %u, switch 2: %u\n",
	       (bool)(buttons & BUTTON_1), (bool)(buttons & BUTTON_2),
	       (bool)(buttons & SWITCH_1), (bool)(buttons & SWITCH_2));
	

	if((bool)(buttons & SWITCH_1)){
		ble_action(BLE_BGM_CONN);
	}else if (!(bool)(buttons & SWITCH_1)){
		ble_action(BLE_STOP_SCAN);
	}

}


void main(void)
{
	printk("Initial ble testing.....\n");

	
	int err = dk_buttons_init(button_handler);
	if (err) {
		printk("Could not initialize buttons, err code: %d\n", err);
	}

	ble_init();
	


}
```

## src/ble.c
```c
/* main.c - Application main entry point */

/*
 * Copyright (c) 2015-2016 Intel Corporation
 *
 * SPDX-License-Identifier: Apache-2.0
 */

#include <zephyr/types.h>
#include <stdio.h>
#include <stddef.h>
#include <errno.h>

#include <zephyr.h>
#include <sys/printk.h>

#include <bluetooth/bluetooth.h>
#include <bluetooth/hci.h>
#include <bluetooth/conn.h>
#include <bluetooth/uuid.h>
#include <bluetooth/gatt.h>

#include <sys/byteorder.h>

#include "lib/common.h"

#define SCAN_INTERVAL 0x0140 /* 200 ms */
#define SCAN_WINDOW 0x0030	 /* 30 ms */
#define INIT_INTERVAL 0x0010 /* 10 ms */
#define INIT_WINDOW 0x0010	 /* 10 ms */
#define CONN_INTERVAL 0x00A0 /* 200 ms */
#define CONN_LATENCY 0

#define CONN_TIMEOUT MIN(MAX((CONN_INTERVAL * 125 *               \
							  MAX(CONFIG_BT_MAX_CONN, 6) / 1000), \
							 10),                                 \
						 3200)

// BGM uuid
#define BT_UUID_BGM_SERVICE BT_UUID_DECLARE_16(0xfee0)
#define BT_UUID_BGM_PCL BT_UUID_DECLARE_16(0xfee1)
#define BT_UUID_BGM_NOTIFY BT_UUID_DECLARE_16(0xfee2)
#define BT_UUID_BGM_WRITE BT_UUID_DECLARE_16(0xfee3)

// BGM handle
#define BT_HANDLE_BGM_PCL 45
#define BT_HANDLE_BGM_NOTIFY 48
#define BT_HANDLE_BGM_WRITE 52

// BGM Response code
#define BGM_FW_VERSION 0x01	   // 0xfe
#define BGM_ONE_RECODE 0x02	   // 0x9e
#define BGM_EIGHT_RECORD 0x08  // 0x9d
#define BGM_SERIAl_NUMBER 0x0b // 0x37

#define MAX_EIGHT_DATA 132
#define RESP_SIZE 1024
#define SN_SIZE 13

#define POST_DATA "{\"serial_number\": \"%s\",\"device_address\": \"%s\",\"data_index\": \"%u\",\"blood_glucose\": \"%u\",\"marker\": \"%s\",\"data_time\": \"%u-%u-%uT%u:%u%s\"}"


enum BGM_Marker
{
	BEFORE_MEAL,
	AFTER_MEAL,
	NO_MEAL,
	MOON_MEAL,
	BEDTIME_MEAL,
	SPORT_MEAL,
	WAKEUP_MEAL,
};

enum BGM_RESP_IDX
{
	RESP_CODE = 0,
	RESP_DATA_IDX = 1,
	IND_L = 4,
	IND_H,
	DA_0,
	DA_1,
	DA_2,
	DA_3,
	DA_4,
	DA_5,
};

static void start_scan();

static uint8_t volatile conn_count;
static uint8_t volatile conn_index;
static bool volatile is_disconnecting;
static bool  is_discovering;

static int volatile default_opcode;

static char ble_resp[RESP_SIZE];
static char sn[SN_SIZE];

static struct bt_uuid_16 uuid;
char devname[64];
struct bt_gatt_read_params conn_param;
static struct bt_conn *connections[CONFIG_BT_MAX_CONN];
static struct bt_gatt_discover_params discover_params;
static struct bt_gatt_subscribe_params subscribe_params[CONFIG_BT_MAX_CONN];

uint8_t eight_records[MAX_EIGHT_DATA];
int top = -1;
bool get_eight_records = false;

void print_resp_bytes(const void *pt, const uint8_t length, uint16_t data_length)
{
	union
	{
		uint8_t data8;
		uint16_t data16;
		uint32_t data32;
	} u32;
	const unsigned char *u8ptr = pt;

	for (uint8_t k = 0; k < data_length; k++)
	{
		switch (length)
		{
		case 16:
			memcpy(&u32.data16, u8ptr, sizeof(u32.data16));
			printk("0x%04" PRIx16 " ", u32.data16);
			u8ptr += sizeof(u32.data16);
			break;
		case 32:
			memcpy(&u32.data32, u8ptr, sizeof(u32.data32));
			printk("0x%08" PRIx32 " ", u32.data32);
			u8ptr += sizeof(u32.data32);
			break;
		default:
			printk("0x%02" PRIx8 " ", *u8ptr);
			u8ptr++;
			break;
		}
	}

	printk("\n\n");
}

void bgm_marker_to_str(const uint16_t marker, char *str, size_t len)
{

	switch (marker)
	{
	case BEFORE_MEAL:
		snprintk(str, len, "%s", "Befoare Meal");
		break;
	case AFTER_MEAL:
		snprintk(str, len, "%s", "After Meal");
		break;
	case NO_MEAL:
		snprintk(str, len, "%s", "No Meal");
		break;
	case MOON_MEAL:
		snprintk(str, len, "%s", "Moon Meal");
		break;
	case BEDTIME_MEAL:
		snprintk(str, len, "%s", "BedTime Meal");
		break;
	case SPORT_MEAL:
		snprintk(str, len, "%s", "Sport Meal");
		break;
	case WAKEUP_MEAL:
		snprintk(str, len, "%s", "Wakeup Meal");
		break;
	default:
		(void)memset(str, 0, len);
		return;
	}
}

void bgm_timezon_to_str(const uint16_t timezone, char *str, size_t len)
{

	if (timezone > 0xC)
	{
		snprintk(str, len, "-%02u:00", (timezone - 0xC));
	}
	else
	{
		snprintk(str, len, "+%02u:00", (0xC - timezone));
	}
}
void push(uint8_t *arr, uint8_t data)
{
	if (top >= MAX_EIGHT_DATA)
	{
		printk("Can't push to array.\n");
	}
	else
	{
		top++;
		arr[top] = data;
	}
}

uint8_t read_cb(struct bt_conn *conn, uint8_t err,
				struct bt_gatt_read_params *params,
				const void *data, uint16_t length)
{

	printk("in read cb\n");
	if (err)
	{

		printk("read err %u", err);
		// return 0;
	}

	memset(devname, 0, 64);
	memcpy(devname, data, length);
	return 0;
}

void write_cb(struct bt_conn *conn, uint8_t err,
			  struct bt_gatt_write_params *params)
{
	if (err)
	{
		printk("Write request completed with BT_ATT_ERR 0x%02x\n", err);
		printk("Write request completed with BT_ATT_ERR %d\n", err);
	}
	else
	{
		printk("Write Sucessfull handle %u data length:%d\n", params->handle, params->length);
	}
}

static uint8_t notify_func(struct bt_conn *conn,
						   struct bt_gatt_subscribe_params *params,
						   const void *data, uint16_t length)
{
	if (!data)
	{
		printk("[UNSUBSCRIBED]\n");
		params->value_handle = 0U;

		return BT_GATT_ITER_STOP;
	}

	char addr[BT_ADDR_LE_STR_LEN];
	bt_addr_to_str(bt_conn_get_dst(conn), addr, sizeof(addr));

	printk("[NOTIFICATION] %s\n", addr);

	
	if (data)
	{
		printk("Length :%d\n", length);

		// convert data to uint8 arrays
		uint8_t recv_data[length];
		memcpy(recv_data, data, length);

		// print_resp_bytes(data,8,length);
		switch (recv_data[RESP_CODE])
		{

		case BGM_ONE_RECODE:
		{
			uint8_t record_idx = (recv_data[IND_H] << 8) + recv_data[IND_L];
			printk("Record_idx : 0x%02x\n", record_idx);

			// parser fisrt response data
			if ((record_idx > 0) & (recv_data[RESP_DATA_IDX] == 1))
			{

				uint16_t year = (recv_data[DA_3] & 0x7F) + 0x7D0;
				uint16_t month = ((recv_data[DA_1] & 0xC0) >> 4) + ((recv_data[DA_0] & 0xC0) >> 6) + 1;
				uint16_t day = (recv_data[DA_0] & 0x1F) + 1;
				uint16_t hour = recv_data[DA_1] & 0x1F;
				uint16_t minute = recv_data[DA_2] & 0x3F;
				uint16_t glucose = ((recv_data[DA_4] & 0x03) << 8) + recv_data[DA_5];
				uint16_t timezone = ((recv_data[DA_1] & 0x20) >> 5) + ((recv_data[DA_2] & 0xC0) >> 5) + ((recv_data[DA_4] & 0xC0) >> 3);
				uint16_t marker = ((recv_data[DA_4] & 0x38) >> 3);
				char tz[10];
				bgm_timezon_to_str(timezone, tz, sizeof(tz));

				char marker_str[20];
				bgm_marker_to_str(marker, marker_str, sizeof(marker_str));
				// printk("%s Glucose:%u (%u/%u/%u %u:%u GMT %s)\n", marker_str, glucose, year, month, day, hour, minute, tz);

				snprintk(ble_resp, RESP_SIZE, POST_DATA, sn, addr, record_idx, glucose, marker_str, year, month, day, hour, minute, tz);
				printk("%s\n", ble_resp);

				
			}
			else if (recv_data[RESP_DATA_IDX] == 1)
			{
				uint16_t total_amount = (recv_data[DA_1] << 8) + recv_data[DA_0];
				uint16_t last_transfer = (recv_data[DA_5] << 8) + recv_data[DA_4];
				uint16_t max_amount = (recv_data[DA_3] << 8) + recv_data[DA_2];
				printk("Total Amount : 0x%03x\n", total_amount);
				printk("Last Transfer : 0x%03x\n", last_transfer);
				printk("Max Amount : %u\n", max_amount);
			}
			int err;

			// err = bt_gatt_unsubscribe(connections[conn_index], &subscribe_params[conn_index]);
			// if (err)
			// {
			// 	printk("unsunscribe error %d\n", err);
			// }

			// err = bt_conn_disconnect(connections[conn_index], BT_HCI_ERR_REMOTE_USER_TERM_CONN);
			// if (err) {

			// 	char addr[BT_ADDR_LE_STR_LEN];
			// 	int err;

			// 	bt_addr_le_to_str(bt_conn_get_dst(connections[conn_index]), addr, sizeof(addr));

			// 	printk("Failed disconnection %s.\n", addr);
			// }

			break;
		}
		// entry it will merge bytes array
		case BGM_EIGHT_RECORD:
		{
			int idx = 0;

			if (recv_data[RESP_DATA_IDX] == 7)
			{
				get_eight_records = true;
			}
			if (recv_data[RESP_DATA_IDX] != 1)
			{
				idx = 2;
			}

			// for(idx;idx < length;idx++) {
			// 	push(&eight_records, resp[idx]);
			// }

			while (idx < length)
			{
				push(&eight_records, recv_data[idx]);
				idx++;
			}

			break;
		}
		case BGM_SERIAl_NUMBER:
		{	
			memcpy(sn, data, length);
			sn[length -1] = '\0';    
			trim(sn);
			printk("global sn:%s\n",sn);
			break;
		}

		}

		// print eight records
		if (get_eight_records)
		{
			for (int i = 0; i < 8; i++)
			{
				int add_idx = 16 * i;
				uint16_t year = (eight_records[DA_3 + add_idx] & 0x7F) + 0x7D0;
				uint16_t month = ((eight_records[DA_1 + add_idx] & 0xC0) >> 4) + ((eight_records[DA_0 + add_idx] & 0xC0) >> 6) + 1;
				uint16_t day = (eight_records[DA_0 + add_idx] & 0x1F) + 1;
				uint16_t hour = eight_records[DA_1 + add_idx] & 0x1F;
				uint16_t minute = eight_records[DA_2 + add_idx] & 0x3F;
				uint16_t glucose = ((eight_records[DA_4 + add_idx] & 0x03) << 8) + eight_records[DA_5 + add_idx];
				uint16_t timezone = ((eight_records[DA_1 + add_idx] & 0x20) >> 5) + ((eight_records[DA_2 + add_idx] & 0xC0) >> 5) + ((eight_records[DA_4 + add_idx] & 0xC0) >> 3);
				uint16_t marker = ((eight_records[DA_4 + add_idx] & 0x38) >> 3);

				char tz[10];
				bgm_timezon_to_str(timezone, tz, sizeof(tz));

				char dest[20];
				bgm_marker_to_str(marker, dest, sizeof(dest));
				printk("%s Glucose:%u (%u/%u/%u %u:%u GMT %s)\n", dest, glucose, year, month, day, hour, minute, tz);
			}

			get_eight_records = false;
			top = -1;
			memset(eight_records, 0, MAX_EIGHT_DATA);
		}

		// int err = bt_gatt_unsubscribe(connections[conn_index], &subscribe_params[conn_index]);
		// if (err){
		// 	printk("unsunscribe error %d\n",err);
		// }
	}

	return BT_GATT_ITER_CONTINUE;
}

static uint8_t discover_func(struct bt_conn *conn,
							 const struct bt_gatt_attr *attr,
							 struct bt_gatt_discover_params *params)
{
	int err;

	if (!attr)
	{
		printk("Discover complete\n");
		(void)memset(params, 0, sizeof(*params));
		return BT_GATT_ITER_STOP;
	}

	char addr[BT_ADDR_LE_STR_LEN];
	bt_addr_le_to_str(bt_conn_get_dst(conn), addr, sizeof(addr));

	printk("[ATTRIBUTE] handle %u %s %u\n", attr->handle, addr, conn_index);

	if (!bt_uuid_cmp(discover_params.uuid, BT_UUID_BGM_SERVICE))
	{
		memcpy(&uuid, BT_UUID_BGM_NOTIFY, sizeof(uuid));
		discover_params.uuid = &uuid.uuid;
		discover_params.start_handle = attr->handle + 1;
		discover_params.type = BT_GATT_DISCOVER_CHARACTERISTIC;

		err = bt_gatt_discover(connections[conn_index], &discover_params);
		if (err)
		{
			printk("Discover failed (err %d)\n", err);
		}
	}
	else if (!bt_uuid_cmp(discover_params.uuid,
						  BT_UUID_BGM_NOTIFY))
	{
		memcpy(&uuid, BT_UUID_GATT_CCC, sizeof(uuid));
		discover_params.uuid = &uuid.uuid;
		discover_params.start_handle = attr->handle + 2;
		discover_params.type = BT_GATT_DISCOVER_DESCRIPTOR;
		subscribe_params[conn_index].value_handle = bt_gatt_attr_value_handle(attr);

		err = bt_gatt_discover(connections[conn_index], &discover_params);
		if (err)
		{
			printk("Discover failed (err %d)\n", err);
		}
	}
	else
	{
		is_discovering = false;
		subscribe_params[conn_index].notify = notify_func;
		subscribe_params[conn_index].value = BT_GATT_CCC_NOTIFY;
		subscribe_params[conn_index].ccc_handle = attr->handle;

		err = bt_gatt_subscribe(connections[conn_index], &subscribe_params[conn_index]);
		if (err && err != -EALREADY)
		{
			printk("Subscribe failed (err %d)\n", err);
		}
		else
		{
			printk("[SUBSCRIBED]\n");

			// Read One Record Type 1(read amount of blood)
			static uint8_t type1_data[] = {0xB0, 0x61, 0x01, 0x00, 0x12};
			static struct bt_gatt_write_params write_op;
			write_op = (struct bt_gatt_write_params){
				.handle = BT_HANDLE_BGM_WRITE,
				.offset = 0,
				.data = &type1_data,
				.length = sizeof(type1_data),
				.func = write_cb,
			};
			err = bt_gatt_write(connections[conn_index], &write_op);
			if (err)
			{
				printk("Write request failed (%d)\n", err);
			}

			// //Read One Record Type2 ( read specific blood glucose)
			// static uint8_t type2_data[] = { 0xB0,0x61,0x07,0x00,0x18 };

			// write_op.data = &type2_data;
			// write_op.length = sizeof(type2_data);

			// err = bt_gatt_write(conn, &write_op);
			// if (err) {
			// 	printk("Write request failed (%d)\n", err);
			// }

			// 	//Read Eight Record
			// 	static uint8_t eight_recode_data[] = { 0xB0,0x62,0x08,0x00,0x1A };

			// 	write_op.data = &eight_recode_data;
			// 	write_op.length = sizeof(eight_recode_data);

			// 	err = bt_gatt_write(conn, &write_op);
			// 	if (err) {
			// 		printk("Write request failed (%d)\n", err);
			// 	}
		}

		return BT_GATT_ITER_STOP;
	}
}

static bool eir_found(struct bt_data *data, void *user_data)
{
	bt_addr_le_t *addr = user_data;
	int i;

	struct bt_conn_le_create_param create_param = {
		.options = BT_CONN_LE_OPT_NONE,
		.interval = INIT_INTERVAL,
		.window = INIT_WINDOW,
		.interval_coded = 0,
		.window_coded = 0,
		.timeout = 0,
	};

	struct bt_le_conn_param conn_param = {
		.interval_min = CONN_INTERVAL,
		.interval_max = CONN_INTERVAL,
		.latency = CONN_LATENCY,
		.timeout = CONN_TIMEOUT,
	};

	// char addr_str[BT_ADDR_LE_STR_LEN];
	// int err;
	// bt_addr_le_to_str(addr, addr_str, sizeof(addr_str));
	// printk("Device found: %s \n", addr_str);
	// printk("[AD]: %u data_len %u\n", data->type, data->data_len);

	switch (data->type)
	{
	case BT_DATA_UUID16_SOME:
	case BT_DATA_UUID16_ALL:
		if (data->data_len % sizeof(uint16_t) != 0U)
		{
			printk("AD malformed\n");
			return true;
		}

		for (i = 0; i < data->data_len; i += sizeof(uint16_t))
		{
			struct bt_le_conn_param *param;
			struct bt_uuid *uuid;
			uint16_t u16;
			int err;

			memcpy(&u16, &data->data[i], sizeof(u16));
			uuid = BT_UUID_DECLARE_16(sys_le16_to_cpu(u16));
			if (bt_uuid_cmp(uuid, BT_UUID_BGM_SERVICE))
			{
				continue;
			}

			err = bt_le_scan_stop();
			if (err)
			{
				printk("Stop LE scan failed (err %d)\n", err);
				continue;
			}

			if (strlen(ble_resp) > 0)
			{

				printk("had data: %s  opcode:%d\n", ble_resp, default_opcode);

			}

			switch (default_opcode)
			{
			case BLE_GET_BGM_ADDR:
			{
				char dest[BT_ADDR_LE_STR_LEN];
				bt_addr_le_to_str(addr, dest, sizeof(dest));
				printk("scaned %s\n", dest);

				start_scan();
				break;
			}
			case BLE_STOP_SCAN:
			{
				break;
			}

			case BLE_BGM_CONN:
			{
				struct bt_conn *temp_conn;
				err = bt_conn_le_create(addr, &create_param, &conn_param,
										&temp_conn);

				if (err)
				{
					char dest[BT_ADDR_LE_STR_LEN];
					bt_addr_le_to_str(addr, dest, sizeof(dest));
					printk("Create conn failed (err %d) address: %s\n", err, dest);
					start_scan();
				}
				else
				{
					conn_index = bt_conn_index(temp_conn);
					char addr[BT_ADDR_LE_STR_LEN];
					bt_addr_le_to_str(bt_conn_get_dst(temp_conn), addr, sizeof(addr));

					printk("temp conn index:%u %s\n", conn_index, addr);
					connections[conn_index] = temp_conn;
					temp_conn = NULL;
					return false;
				}

				break;
			}

			default:
			{
				start_scan();
				break;
			}
			}

			return false;
		}
	}

	return true;
}

static void device_found(const bt_addr_le_t *addr, int8_t rssi, uint8_t type,
						 struct net_buf_simple *ad)
{

	// printk all ble device
	//  char dev[BT_ADDR_LE_STR_LEN];
	//  bt_addr_le_to_str(addr, dev, sizeof(dev));
	//  printk("[DEVICE]: %s, AD evt type %u, AD data len %u, RSSI %i\n",
	//         dev, type, ad->len, rssi);

	if (type == BT_GAP_ADV_TYPE_ADV_IND ||
		type == BT_GAP_ADV_TYPE_ADV_DIRECT_IND)
	{

		bt_data_parse(ad, eir_found, (void *)addr);
		/* We're only interested in connectable events */
	}
	else if (type != BT_GAP_ADV_TYPE_ADV_IND &&
			 type != BT_GAP_ADV_TYPE_ADV_DIRECT_IND)
	{
		return;
	}
}

static void start_scan()
{
	int err;

	/* Use active scanning and disable duplicate filtering to handle any
	 * devices that might update their advertising data at runtime. */
	struct bt_le_scan_param scan_param = {
		.type = BT_LE_SCAN_TYPE_ACTIVE,
		.options = BT_LE_SCAN_OPT_NONE,
		.interval = BT_GAP_SCAN_FAST_INTERVAL,
		.window = BT_GAP_SCAN_FAST_WINDOW,
	};

	err = bt_le_scan_start(&scan_param, device_found);
	if (err)
	{
		printk("Scanning failed to start (err %d)\n", err);
		return;
	}

	printk("Scanning successfully started\n");
}

static void connected(struct bt_conn *conn, uint8_t conn_err)
{
	char addr[BT_ADDR_LE_STR_LEN];
	int err;

	bt_addr_le_to_str(bt_conn_get_dst(conn), addr, sizeof(addr));

	if (conn_err)
	{
		printk("Failed to connect to %s (%u)\n", addr, conn_err);

		bt_conn_unref(connections[conn_index]);
		connections[conn_index] = NULL;

		start_scan();
		return;
	}

	for (int i = 0; i < CONFIG_BT_MAX_CONN; i++)
	{
		if (connections[i])
		{

			char addr[BT_ADDR_LE_STR_LEN];
			bt_addr_le_to_str(bt_conn_get_dst(connections[i]), addr, sizeof(addr));
			printk("Connections: %d, %s\n", i, addr);
		}
		else
		{
			printk("Connections %d empty.\n", i);
		}
	}

	if (conn == connections[conn_index])
	{
		printk("Initial discover function (%u).\n", conn_index);

		static uint8_t data[] = {0x00};
		static struct bt_gatt_write_params write_op;
		write_op = (struct bt_gatt_write_params){
			.handle = BT_HANDLE_BGM_PCL,
			.offset = 0,
			.data = &data,
			.length = sizeof(data),
			.func = write_cb,
		};
		err = bt_gatt_write(connections[conn_index], &write_op);
		if (err)
		{
			printk("Write request failed (%d)\n", err);
		}

		// if (!is_discovering)
		// {
		// 	printk("in discovering.\n");
			is_discovering = true;

			memcpy(&uuid, BT_UUID_BGM_SERVICE, sizeof(uuid));
			discover_params.uuid = &uuid.uuid;
			discover_params.func = discover_func;
			discover_params.start_handle = BT_ATT_FIRST_ATTRIBUTE_HANDLE;
			discover_params.end_handle = BT_ATT_LAST_ATTRIBUTE_HANDLE;
			discover_params.type = BT_GATT_DISCOVER_PRIMARY;

			err = bt_gatt_discover(conn, &discover_params);
			if (err)
			{
				printk("Discover failed(err %d)\n", err);
				return;
			}
		// }
	}

	conn_count++;

	if (conn_count < CONFIG_BT_MAX_CONN)
	{
		start_scan();
	}

	printk("Connected (%u): %s\n", conn_count, addr);
}

static void disconnected(struct bt_conn *conn, uint8_t reason)
{
	char addr[BT_ADDR_LE_STR_LEN];

	bt_addr_le_to_str(bt_conn_get_dst(conn), addr, sizeof(addr));

	printk("Disconnected: %s (reason 0x%02x)\n", addr, reason);

	connections[conn_index] = NULL;
	bt_conn_unref(conn);

	if ((conn_count == 1U) && is_disconnecting)
	{
		is_disconnecting = false;
		start_scan();
	}
	conn_count--;
}

BT_CONN_CB_DEFINE(conn_callbacks) = {
	.connected = connected,
	.disconnected = disconnected,
};

static void auth_cancel(struct bt_conn *conn)
{
	char addr[BT_ADDR_LE_STR_LEN];

	bt_addr_le_to_str(bt_conn_get_dst(conn), addr, sizeof(addr));

	printk("Pairing cancelled: %s\n", addr);
}

static void pairing_confirm(struct bt_conn *conn)
{
	char addr[BT_ADDR_LE_STR_LEN];

	bt_addr_le_to_str(bt_conn_get_dst(conn), addr, sizeof(addr));

	bt_conn_auth_pairing_confirm(conn);

	printk("Pairing confirmed: %s\n", addr);
}

static void pairing_complete(struct bt_conn *conn, bool bonded)
{
	char addr[BT_ADDR_LE_STR_LEN];

	bt_addr_le_to_str(bt_conn_get_dst(conn), addr, sizeof(addr));

	printk("Pairing completed: %s, bonded: %d\n", addr, bonded);
}

static void pairing_failed(struct bt_conn *conn, enum bt_security_err reason)
{
	char addr[BT_ADDR_LE_STR_LEN];

	bt_addr_le_to_str(bt_conn_get_dst(conn), addr, sizeof(addr));

	printk("Pairing failed conn: %s, reason %d\n", addr,
		   reason);
}

static struct bt_conn_auth_cb conn_auth_callbacks = {
	.cancel = auth_cancel,
	.pairing_confirm = pairing_confirm,
	.pairing_complete = pairing_complete,
	.pairing_failed = pairing_failed};

static void bt_ready(int err)
{
	// k_busy_wait(10 * 1000); // DB hash delayed work is 10 MS
	if (IS_ENABLED(CONFIG_SETTINGS))
	{
		settings_load();
	}

	err = bt_conn_auth_cb_register(&conn_auth_callbacks);
	if (err)
	{
		printk("Failed to register authorization callbacks.\n");
		return;
	}

	start_scan();
}

static void disconnect(struct bt_conn *conn, void *data)
{
	char addr[BT_ADDR_LE_STR_LEN];
	int err;

	bt_addr_le_to_str(bt_conn_get_dst(conn), addr, sizeof(addr));

	printk("Disconnecting %s...\n", addr);
	err = bt_conn_disconnect(conn, BT_HCI_ERR_REMOTE_USER_TERM_CONN);
	if (err)
	{
		printk("Failed disconnection %s.\n", addr);
	}
	printk("success.\n");
}

void ble_action(int opcode)
{

	// if last action was stop scan ,it will rescan ble devices.
	if (default_opcode == BLE_STOP_SCAN)
	{
		start_scan();
	}

	default_opcode = opcode;
}

void get_ble_resp(char *resp, int buffersize)
{

	if (!resp || buffersize < 1)
		return;
	if (!strlen(ble_resp))
	{
		*resp = '\0'; // Return an 'empty' string
	}
	else
	{
		size_t length = strlen(ble_resp);
		strncpy(resp, ble_resp, length);

		resp[length - 1] = '\0';
	}
}

void ble_init(void)
{

	int err;

	err = bt_enable(bt_ready);

	if (err)
	{
		printk("Bluetooth init failed (err %d)\n", err);
		return;
	}

	printk("Bluetooth initialized\n");



}
```

## src/ble.h
```c
/*
 * Copyright (c) 2018 Nordic Semiconductor ASA
 *
 * SPDX-License-Identifier: LicenseRef-Nordic-5-Clause
 */

#ifndef _BLE_H_
#define _BLE_H_

void ble_action(int opcode);
void ble_init(void);
void get_ble_resp(char* resp, int buffersize);

#endif /* _BLE_H_ */
```

## src/common.h
```c
/*
 * Copyright (c) 2018 Nordic Semiconductor ASA
 *
 * SPDX-License-Identifier: LicenseRef-Nordic-5-Clause
 */



enum BLE_OPCODE
{   
    BLE_INIT,
	BLE_BGM_CONN,
	BLE_GET_BGM_ADDR,
    BLE_STOP_SCAN,
};
```

## src/lte.c
```c
/*
 * Copyright (c) 2020 Nordic Semiconductor ASA
 *
 * SPDX-License-Identifier: LicenseRef-Nordic-5-Clause
 */

#include <stdio.h>
#include <string.h>
#include <zephyr.h>
#include <stdlib.h>
#include <net/socket.h>
#include <modem/nrf_modem_lib.h>
#include <modem/lte_lc.h>
#include <modem/modem_key_mgmt.h>


#include "lib/common.h"
#include "lib/yyjson.h"



#define BUF_SIZE 2048

#define HTTP_GET "GET"
#define HTTP_POST "POST"


#define HTTP_PORT "8000"
#define HTTP_HOSTNAME "reui.dsmynas.com"


#define HTTP_HEAD                                       \
    "HTTP/1.1\r\n"                                \
    "Host: " HTTP_HOSTNAME ":" HTTP_PORT  "\r\n"                  \
    "Content-Type: application/json; charset=utf-8\r\n" \
    "Connection: close\r\n"



void modem_configure(void)
{
	if (IS_ENABLED(CONFIG_LTE_AUTO_INIT_AND_CONNECT)) {
		/* Do nothing, modem is already turned on and connected. */
	} else {
		int err;
		printk("Establishing LTE link (this may take some time) ...\n");
		err = lte_lc_init_and_connect();
        // err = lte_lc_init_and_connect_async(NULL);
        
		__ASSERT(err == 0, "LTE link could not be established.");
	}
}


int tcp_socket_open(const char *host, uint16_t host_port)
{
    int err;
    int fd;


    struct addrinfo *res;
    struct addrinfo hints = {
        .ai_family = AF_INET,
        .ai_socktype = SOCK_STREAM,
    };


    err = getaddrinfo(host, NULL, &hints, &res);
    if (err)
    {
        printk("getaddrinfo() failed, err %d\n", errno);
        return -1;
    }

    ((struct sockaddr_in *)res->ai_addr)->sin_port = htons(host_port);

    fd = socket(PF_INET, SOCK_STREAM, IPPROTO_TCP);
    if (fd == -1)
    {
        printk("Failed to open socket!\n");
        goto clean_up;
    }


    //setting recv and send timeout
    struct timeval timeout;
    timeout.tv_sec = 10;
    timeout.tv_usec = 0;

    if (setsockopt(fd, SOL_SOCKET, SO_RCVTIMEO, &timeout,
                   sizeof timeout) < 0)
    {
        printk("setsockopt failed\n");
    }

    if (setsockopt(fd, SOL_SOCKET, SO_SNDTIMEO, &timeout,
                   sizeof timeout) < 0)
    {
        printk("setsockopt failed\n");
    }

    printk("Connecting to %s\n", HTTP_HOSTNAME);
    err = connect(fd, res->ai_addr, sizeof(struct sockaddr_in));
    if (err)
    {
        printk("connect() failed, err: %d\n", errno);
        goto clean_up;
    }

clean_up:
    freeaddrinfo(res);
    if (err) 
	{
		(void)close(fd);
		fd = -1;
	}

	return fd;
}




void post_blood_glucose(char * post_data)
{


    char *resp_status;
    int bytes;
    size_t off;

    char recv_buf[BUF_SIZE];
    char send_buf[BUF_SIZE];

    // char *post_data =  "{\"serial_number\":\"2772UAQ0214\",\"device_address\":\"B0:C2:05:09:C1:C3\",\"data_index\":\"1\",\"blood_sugar\":\"157\",\n"
    //                    "\"timezone\":\"GMT+8\"}";
    char *post_url = "/blood_glucose";
    sprintf(send_buf, HTTP_POST " %s " HTTP_HEAD "Content-Length: %d\r\n\r\n%s" ,post_url,strlen(post_data),post_data);

    // char *get_url = "/";
    // sprintf(send_buf, HTTP_GET " %s " HTTP_HEAD "\r\n",get_url);
    int head_len = strlen(send_buf);

    int fd = tcp_socket_open(HTTP_HOSTNAME,atoi(HTTP_PORT));

    off = 0;
    do
    {
        bytes = send(fd, &send_buf[off], head_len - off, 0);
        if (bytes < 0)
        {
            printk("send() failed, err %d\n", errno);
            (void)close(fd);

        }
        off += bytes;
    } while (off < head_len);

    printk("Sent %d bytes\n", off);

    off = 0;
    do
    {
        bytes = recv(fd, &recv_buf[off], BUF_SIZE - off, 0);
        if (bytes < 0)
        {
            printk("recv() failed, err %d\n", errno);
            (void)close(fd);
            break;
        }
        off += bytes;
    } while (bytes != 0 /* peer closed connection */);

    printk("Received %d bytes\n", off);


    char **arr = NULL;
    int content_length = 0;

    int lines = split(recv_buf, '\r\n', &arr);

    for (int i = 0; i < lines; i++)
    {    
        char *line = arr[i];

        //get body length
        char *substr = "Content-Length: ";
        char *match = strstr(line, substr);
       

        if (match) {
            remove_substr(line, substr);
            content_length = atoi(line);
        }


        // get response json body
        if (i == lines - 1 && content_length != 0)
        {
            line[content_length ] ='\0';
            printk("%s [%d]\n",line,strlen(line));

            // // Read JSON
            // yyjson_doc *doc = yyjson_read(line, strlen(line), 0);
            // yyjson_val *root = yyjson_doc_get_root(doc);

            // yyjson_val *message = yyjson_obj_get(root, "message");
            // printk("message: %s\n", yyjson_get_str(message));
            // printk("message length:%d\n", (int)yyjson_get_len(message));
        }
    }

    /* Print HTTP response */
    resp_status = strstr(recv_buf, "\r\n");

    if (resp_status)
    {
        off = resp_status - recv_buf;
        recv_buf[off + 1] = '\0';
        printk("\n>\t %s\n\n", recv_buf);
    }

    printk("Finished, closing socket.\n");


    // lte_lc_power_off();
}
```

## src/lte.h
```c
/*
 * Copyright (c) 2018 Nordic Semiconductor ASA
 *
 * SPDX-License-Identifier: LicenseRef-Nordic-5-Clause
 */

#ifndef _LTE_H_
#define _LTE_H_

void post_blood_glucose(char * post_data);
void modem_configure(void);
#endif /* _LTE_H_ */
```
